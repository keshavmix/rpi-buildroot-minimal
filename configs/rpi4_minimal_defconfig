## configs/rpi4_minimal_defconfig
```kconfig
# Minimal Buildroot defconfig for Raspberry Pi 4
BR2_arm=y
BR2_cortex_a72=y
BR2_TOOLCHAIN_BUILDROOT_MUSL=y
BR2_PACKAGE_BUSYBOX=y
BR2_PACKAGE_DROPBEAR=y
BR2_TARGET_GENERIC_HOSTNAME="rpi"
BR2_ROOTFS_OVERLAY="overlay/"
# Kernel (let Buildroot fetch & build a kernel)
BR2_LINUX_KERNEL=y
BR2_LINUX_KERNEL_CUSTOM_VERSION=y
BR2_LINUX_KERNEL_CUSTOM_VERSION_VALUE="6.6.0"
# (Optional) choose default defconfig for Raspberry Pi (bcm2711/bcmrpi_defconfig)
# Some buildroot kernels expect a defconfig name; adjust if necessary.
```
